# tico_decoder_model: IP-XACT component
VLNV IcronTechnologies:IcronTechnologies:tico_decoder_model:1.0

## Parameters
addr_width = 8
bus_width = 32

## Bus interfaces (logical=physical port)
default_map: slave AGNISYS:AGNISYS:AXI:1.0, memory map tico_decodermap
  aclk=aclk, aresetn=aresetn, awaddr=awaddr, awvalid=awvalid, awready=awready, awprot=awprot, wdata=wdata, wvalid=wvalid, wready=wready, wstrb=wstrb, bresp=bresp, bready=bready, bvalid=bvalid, araddr=araddr, arvalid=arvalid, arready=arready, arprot=arprot, rdata=rdata, rvalid=rvalid, rready=rready, rresp=rresp

## Ports
in aclk
in aresetn
in awaddr[addr_width -1:0]
in awvalid
out awready
in awprot[2:0]
in wdata[bus_width -1:0]
in wvalid
out wready
in wstrb[(bus_width div 8 )-1:0]
out bresp[1:0]
in bready
out bvalid
in araddr[addr_width -1:0]
in arvalid
out arready
in arprot[2:0]
out rdata[bus_width -1:0]
out rvalid
in rready
out rresp[1:0]
out tico_decoder_regstico_d_config_enb
out tico_decoder_regstico_d_config_tico_d_config_r[1:0]
out tico_decoder_regstico_d_width_tico_d_width_r[15:0]
out tico_decoder_regstico_d_height_tico_d_height_r[15:0]
out tico_decoder_regstico_d_comp_tico_d_comp_r[1:0]
out tico_decoder_regstico_d_mode_enb
out tico_decoder_regstico_d_mode_tico_d_mode_r[1:0]
out tico_decoder_regstico_d_hlvls_tico_d_hlvls_r[2:0]
out tico_decoder_regstico_d_vld_enb
out tico_decoder_regstico_d_vld_tico_d_vld_r
out tico_decoder_regstico_d_nbr_enb
out tico_decoder_regstico_d_nbr_tico_d_nbr_r[15:0]
out tico_decoder_regstico_d_bgt_tico_d_bgt_r[31:0]
out tico_decoder_regstico_d_vid_depth_tico_d_vid_depth_r[3:0]
out tico_decoder_regstico_d_play_mode_enb
out tico_decoder_regstico_d_play_mode_tico_d_play_mode_r
out tico_decoder_regstico_d_profile_tico_d_profile_r[1:0]
out tico_decoder_regstico_d_line_duration_enb
out tico_decoder_regstico_d_line_duration_tico_d_line_duration_r[15:0]
out tico_decoder_regstico_d_img_size_enb
out tico_decoder_regstico_d_img_size_tico_d_line_duration_r[31:0]

## Address spaces and blocks
tico_decodermap.tico_decoder: base 0x000, range 0x100, width 32

## Registers
Registers are 32-bit, read-only, reset 0x0 unless marked. A register's access mark holds for its fields unless they carry their own. Offsets are from the block's base; lines under a group give offsets from that group; [hi:lo] are bit positions; {n}, {i} and the like mark numbered series; 'fields as' and 'values as' point back to an identical list; <NAME> marks a mode.

## tico_decodermap.tico_decoder — TICO Decoder Registers
Base 0x00000000
0x10 tico_d_config rw
  [1:0] tico_d_config — This register sets general core configuration parameters. bit 0: AUTO-RESET Set to '1' to force a user_rst and core_rst after the last output data, on each frame. This feature is transparent and automatic, and does not change the control nor its configuration. It resets the core between frames to prevent rare cases in which the core remains in a bad state after processing a frame whose codestream was corrupted. See also the WaitLastCS bit below for further details. Set to '0' (default) to disable this feature. bit 1: WaitLastCS Set to '1' to wait for both the last codestream input data and the last video output data before auto-resetting the core, in auto-reset mode or when an error occurred. This mode can be selected when the input codestream is reliable or is at least guaranteed to contain a 'last data' flag. This mode must be selected when vid_ fixed_latency_flag is not monitored and the last codestream word could arrive after the last video output word. Set to '0' (default) to wait for the last output video data only, before auto-resetting the core. This mode must be chosen when the input codestream may have missing or corrupted data, especially if the last codestream word may be missing. CONFIDENTIAL and
0x14 tico_d_width
  [15:0] tico_d_width — Image width, in pixels. Must be a multiple of 2. Up to 2048 for HD core flavor, 4096 for 4K core flavor, 8192 for 8K core flavor, and 10240 for 10K core flavor.
0x1C tico_d_height
  [15:0] tico_d_height — Image height, in pixels. Must be a multiple of 2, and greater than or equal to 2 in profile 1, 8 in profile 2.
0x24 tico_d_comp
  [1:0] tico_d_comp — Number of color components. Fixed to 3.
0x2C tico_d_mode rw
  [1:0] tico_d_mode — bit 1-0: (R) sub-sampling mode (extracted from picture header) 00b = 4:4:4 01b = 4:2:2 10b = 4:2:0 bit 2: (R/W) downscale set to '1' to downscale output resolution by a factor 2. set to '0' for standard resolution. (default)
0x34 tico_d_hlvls
  [2:0] tico_d_hlvls — Number of horizontal decompositions in the horizontal wavelet transform. Fixed to 5.
0x38 tico_d_vld wo
  [0] tico_d_vld — Contains several mode configuration fields: bit 1-0: (R) sub-sampling mode (extracted from picture header), 00b = 4:4:4, 01b = 4:2:2, 10b = 4:2:0 bit 2: (R/W) downscale set to '1' to downscale output resolution by a factor 2. set to '0' for standard resolution. (default)
0x3C tico_d_nbr rw
  [15:0] tico_d_nbr — Number of images to play when the core is in command mode.
0x44 tico_d_bgt
  [31:0] tico_d_bgt — Budget in bytes for a single picture. The budget is allocated to the picture header and the compressed data. Note: To compute this value according to a bit per pixel rate: budget = bpp x width x height / 8
0x48 tico_d_vid_depth
  [3:0] tico_d_vid_depth — Bit depth of the video content, mapped on the MSBs of the port interface. The valid bit depths are 8, 10 and 12 bits per component 4'b1000: 8 bits 4'b1010: 10 bits 4'b1100: 12 bits
0x4C tico_d_play_mode wo
  [0] tico_d_play_mode — It allows to choose between two running modes: - set to '1' to run in play mode, in which the core processes frames continuously. - set to '0' to run in command mode, in which the core processes n frames, n defined by TICO_D_NBR.
0x58 tico_d_profile
  [1:0] tico_d_profile — Codestream profile: 1: Profile 1 2: Profile 2 The profile must be compliant with the core performance and configuration.
0x80 tico_d_line_duration rw
  [15:0] tico_d_line_duration — Number of clock cycles per video line (horizontal blanking included). This register is used to generate the fixed latency flag signal.
0x84 tico_d_img_size rw
  [31:0] tico_d_line_duration — Image size configuration of the Video Out Synchronizer. When this register is null, the Video Out Synchronizer takes the image size from the codestream header. Otherwise, it takes it from this register and disregards the codestream header, which is safer in an environment where codestream corruption is possible. bits 31-16: image width bits 15-1: image height / 2 (number of line pairs) bit 0: subsampling mode, 0 = 4:4:4, 1 = 4:2:2 / 4:2:0 Note: this register is only used for the Video Out Synchronizer, not for the TICO decoder which must take the image size from the picture header.
