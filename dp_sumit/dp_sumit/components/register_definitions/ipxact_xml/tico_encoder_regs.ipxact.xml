# tico_encoder_model: IP-XACT component
VLNV IcronTechnologies:IcronTechnologies:tico_encoder_model:1.0

## Parameters
addr_width = 8
bus_width = 32

## Bus interfaces (logical=physical port)
default_map: slave AGNISYS:AGNISYS:AXI:1.0, memory map tico_encodermap
  aclk=aclk, aresetn=aresetn, awaddr=awaddr, awvalid=awvalid, awready=awready, awprot=awprot, wdata=wdata, wvalid=wvalid, wready=wready, wstrb=wstrb, bresp=bresp, bready=bready, bvalid=bvalid, araddr=araddr, arvalid=arvalid, arready=arready, arprot=arprot, rdata=rdata, rvalid=rvalid, rready=rready, rresp=rresp

## Ports
in aclk
in aresetn
in awaddr[addr_width -1:0]
in awvalid
out awready
in awprot[2:0]
in wdata[bus_width -1:0]
in wvalid
out wready
in wstrb[(bus_width div 8 )-1:0]
out bresp[1:0]
in bready
out bvalid
in araddr[addr_width -1:0]
in arvalid
out arready
in arprot[2:0]
out rdata[bus_width -1:0]
out rvalid
in rready
out rresp[1:0]
out tico_e_width_enb
out tico_e_width_tico_e_width_r[15:0]
out tico_e_height_enb
out tico_e_height_tico_e_height_r[15:0]
out tico_e_comp_enb
out tico_e_comp_tico_e_comp_r[1:0]
out tico_e_mode_enb
out tico_e_mode_tico_e_mode_r[3:0]
out tico_e_hlvls_enb
out tico_e_hlvls_tico_e_hlvls_r[2:0]
out tico_e_vld_enb
out tico_e_vld_tico_e_vld_r
out tico_e_nbr_enb
out tico_e_nbr_tico_e_nbr_r[15:0]
out tico_e_bgt_enb
out tico_e_bgt_tico_e_bgt_r[31:0]
out tico_e_vid_depth_enb
out tico_e_vid_depth_tico_e_vid_depth_r[3:0]
out tico_e_play_mode_enb
out tico_e_play_mode_tico_e_play_mode_r
out tico_e_lvl_weights_enb
out tico_e_lvl_weights_tico_e_lvl_weights_r[31:0]

## Address spaces and blocks
tico_encodermap.tico_encoder: base 0x000, range 0x100, width 32

## Registers
Registers are 32-bit, read-write, reset 0x0 unless marked. A register's access mark holds for its fields unless they carry their own. Offsets are from the block's base; lines under a group give offsets from that group; [hi:lo] are bit positions; {n}, {i} and the like mark numbered series; 'fields as' and 'values as' point back to an identical list; <NAME> marks a mode.

## tico_encodermap.tico_encoder
Base 0x00000000
0x14 tico_e_width
  [15:0] tico_e_width — Image width, in pixels. Must be a multiple of 2. Up to 2048 for HD core flavor, 4096 for 4K core flavor, 8192 for 8K core flavor, and 10240 for 10K core flavor.
0x1C tico_e_height
  [15:0] tico_e_height — Image height, in pixels. Must be a multiple of 2, and greater than or equal to 2 in profile 1, 8 in profile 2.
0x24 tico_e_comp
  [1:0] tico_e_comp — Number of color components. Fixed to 3.
0x2C tico_e_mode reset 0x1
  [3:0] tico_e_mode — Configures the color format and sub-sampling - 4'b0000: RGB - 4'b0001 YCbCr422 - 4'b1000 YCbCr444
0x34 tico_e_hlvls
  [2:0] tico_e_hlvls — Number of horizontal decompositions in the horizontal wavelet transform. Fixed to 5.
0x38 tico_e_vld wo
  [0] tico_e_vld — It validates the given configuration. Set to '1' to start the core, after setting mode and images parameters. Note: to start the core, the user_rst signal must also be inactive.
0x3C tico_e_nbr
  [15:0] tico_e_nbr — Number of images to play when the core is in command mode.
0x44 tico_e_bgt
  [31:0] tico_e_bgt — Budget in bytes for a single picture. The budget is allocated to the picture header and the compressed data. Note: To compute this value according to a bit per pixel rate: budget = bpp x width x height / 8
0x48 tico_e_vid_depth
  [3:0] tico_e_vid_depth — Bit depth of the video content, mapped on the MSBs of the port interface. The valid bit depths are 8, 10 and 12 bits per component 4'b1000: 8 bits 4'b1010: 10 bits 4'b1100: 12 bits
0x4C tico_e_play_mode wo
  [0] tico_e_play_mode — It allows to choose between two running modes: - set to '1' to run in play mode, in which the core processes frames continuously. - set to '0' to run in command mode, in which the core processes n frames, n defined by TICO_E_NBR.
0x50 tico_e_lvl_weights
  [31:0] tico_e_lvl_weights — This register is used to program the image quality optimization (visual or PSNR), see Rate allocation configuration and optimization (page 24) section for more details.
